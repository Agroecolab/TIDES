//#include <pgmspace.h>
//#pragma once

#define SECRET
#define THINGNAME "TIDES_4"

class RunningAverage {
  private:
    static const int windowSize = 5;
    float values[windowSize];
    int index = 0;
    int count = 0;
  
  public:
    RunningAverage() {
      for (int i = 0; i < windowSize; i++) {
        values[i] = 0;
      }
    }
  
    float update(float newValue) {
      values[index] = newValue;
      index = (index + 1) % windowSize;
      if (count < windowSize) count++;
      return getAverage();
    }
  
    float getAverage() {
      float sum = 0;
      for (int i = 0; i < count; i++) {
        sum += values[i];
      }
      return count > 0 ? sum / count : 0;
    }
};


//const char WIFI_SSID[] = "umd-iot";
//const char WIFI_PASSWORD[] = "zqzmtinti2d6";  //TideSim1
//const char WIFI_PASSWORD[] = "4buaregbrx9i";  //TideSim2
//const char WIFI_PASSWORD[] = "zfd2qnc45j3w";  //TideSim3
//const char WIFI_PASSWORD[] = "YSUTDuSFEQyC";  //TIDES #2
//const char WIFI_PASSWORD[] = "qsQud5g5bSnX";  //TIDES #1



const char EAP_IDENTITY[] = "";
const char EAP_PASSWORD[] = "";
const char AWS_IOT_ENDPOINT[] = "asewr9znidzzu-ats.iot.us-west-2.amazonaws.com";

/*
// Amazon Root CA 1 (this does not change)
static const char AWS_CERT_CA[] = R"EOF(
-----BEGIN CERTIFICATE-----
MIIDQTCCAimgAwIBAgITBmyfz5m/jAo54vB4ikPmljZbyjANBgkqhkiG9w0BAQsF
ADA5MQswCQYDVQQGEwJVUzEPMA0GA1UEChMGQW1hem9uMRkwFwYDVQQDExBBbWF6
b24gUm9vdCBDQSAxMB4XDTE1MDUyNjAwMDAwMFoXDTM4MDExNzAwMDAwMFowOTEL
MAkGA1UEBhMCVVMxDzANBgNVBAoTBkFtYXpvbjEZMBcGA1UEAxMQQW1hem9uIFJv
b3QgQ0EgMTCCASIwDQYJKoZIhvcNAQEBBQADggEPADCCAQoCggEBALJ4gHHKeNXj
ca9HgFB0fW7Y14h29Jlo91ghYPl0hAEvrAIthtOgQ3pOsqTQNroBvo3bSMgHFzZM
9O6II8c+6zf1tRn4SWiw3te5djgdYZ6k/oI2peVKVuRF4fn9tBb6dNqcmzU5L/qw
IFAGbHrQgLKm+a/sRxmPUDgH3KKHOVj4utWp+UhnMJbulHheb4mjUcAwhmahRWa6
VOujw5H5SNz/0egwLX0tdHA114gk957EWW67c4cX8jJGKLhD+rcdqsq08p8kDi1L
93FcXmn/6pUCyziKrlA4b9v7LWIbxcceVOF34GfID5yHI9Y/QCB/IIDEgEw+OyQm
jgSubJrIqg0CAwEAAaNCMEAwDwYDVR0TAQH/BAUwAwEB/zAOBgNVHQ8BAf8EBAMC
AYYwHQYDVR0OBBYEFIQYzIU07LwMlJQuCFmcx7IQTgoIMA0GCSqGSIb3DQEBCwUA
A4IBAQCY8jdaQZChGsV2USggNiMOruYou6r4lK5IpDB/G/wkjUu0yKGX9rbxenDI
U5PMCCjjmCXPI6T53iHTfIUJrU6adTrCC2qJeHZERxhlbI1Bjjt/msv0tadQ1wUs
N+gDS63pYaACbvXy8MWy7Vu33PqUXHeeE6V/Uq2V8viTO96LXFvKWlJbYK8U90vv
o/ufQJVtMVT8QtPHRh8jrdkPSHCa2XV4cdFyQzR1bldZwgJcJmApzyMZFo6IQ6XU
5MsI+yMRQ+hDKXJioaldXgjUkK642M4UwtBV8ob2xJNDd2ZhwLnoQdeXeGADbkpy
rqXRfboQnoZsG4q5WTP468SQvvG5
-----END CERTIFICATE-----
)EOF";
/*
// Amazon Root CA 1 (this does not change)
static const char AWS_CERT_CA2[] = R"EOF(
-----BEGIN CERTIFICATE-----
MIIDWTCCAkGgAwIBAgIUfjFbuxpkH+LDptvYK/bZstufy3YwDQYJKoZIhvcNAQEL
BQAwTTFLMEkGA1UECwxCQW1hem9uIFdlYiBTZXJ2aWNlcyBPPUFtYXpvbi5jb20g
SW5jLiBMPVNlYXR0bGUgU1Q9V2FzaGluZ3RvbiBDPVVTMB4XDTI2MDUyNjE4MDg0
M1oXDTQ5MTIzMTIzNTk1OVowHjEcMBoGA1UEAwwTQVdTIElvVCBDZXJ0aWZpY2F0
ZTCCASIwDQYJKoZIhvcNAQEBBQADggEPADCCAQoCggEBAM30hBlCbnOQsIr58cVq
6c6W0fQlfHBmRzPkKjvodE7tyI2DEgEoCe/udSjJqSeu8WHky32eenP7OaWXpYVr
ilYNWHdQ2QLCX1oGFguALW8X98s98pCghfBFVLFDYS90wv/TUJ5+UxeIHDaYZFI1
3j9tf+ZX6PWygGgb5OhGxmA5mEqM55SlRhIVZ7Mw2sIk7OVyoFU6HFP1FduxoHwe
g9BV5ISzSqdH3lGsDxfArizLtyMC1em0aGJazRi+TtcKiSPiyC8cS3y0PqaygnuG
ERIqX8OS39IBxIPscYcNKfwEmx97xLZVQfSUC8qYpAp2nvZfRikCAchVt6hte/Uj
C7ECAwEAAaNgMF4wHwYDVR0jBBgwFoAUv9tVoo8rO9mwuiI7odgiBrMF/mowHQYD
VR0OBBYEFItfkt4bHMDl3y1klnIF6ONa9wGHMAwGA1UdEwEB/wQCMAAwDgYDVR0P
AQH/BAQDAgeAMA0GCSqGSIb3DQEBCwUAA4IBAQBceKJ1DZMV75uNsaeFPxyp42TK
SjuurZN2YCZkQ9jsN9INKbApvEn04kLNK5tRgQKrKPksB20eqKZVAdqcg0C3LyhB
hi6p2Qk+bvvm/TJKkYTodMwIYoEGVGA3rwZGZPf3y+gUWKwdksotH/FsuRVphF3o
GviHWiwtZGJ94W0WrcgNA7B5YM8mSQf14lK9u60jHi4iG0tcnWMfWjwKbjey6u/7
fnCLza1WQoAj5jnqcT7M552+7oZG0O19ZhB4QGlWxOAiZfIr1w05IsqipwR38oHq
1VOSsv+sLuyB/DOIpJS+7tlvTzVEEwQmfudTJOo/c9bo9kT0vyebVhYuMEBw
-----END CERTIFICATE-----
)EOF";

// Device Certificate for TideSim1
static const char AWS_CERT_CRT[] PROGMEM = R"KEY(
-----BEGIN CERTIFICATE-----
MIIDWTCCAkGgAwIBAgIUVUpDkqhkpkpgcXF4K0ECNqaXtjUwDQYJKoZIhvcNAQEL
BQAwTTFLMEkGA1UECwxCQW1hem9uIFdlYiBTZXJ2aWNlcyBPPUFtYXpvbi5jb20g
SW5jLiBMPVNlYXR0bGUgU1Q9V2FzaGluZ3RvbiBDPVVTMB4XDTIzMDIyMDIyMjYw
NFoXDTQ5MTIzMTIzNTk1OVowHjEcMBoGA1UEAwwTQVdTIElvVCBDZXJ0aWZpY2F0
ZTCCASIwDQYJKoZIhvcNAQEBBQADggEPADCCAQoCggEBAN3LnJngV4jVb6B1qzLx
WKezUwOlFFpjHFAsrrv6nSruic39MIeZafZRKeUyK5oKWEzoRFbOe6pMano315QN
P2EHmihfIbwgwR8Hdbrm8qMum4oD8x9gQH1qzxOxAsdHQYu10CyoeOmO3Hu6Czpy
6/ok8s2UtNn33ddmq445mmFAi/D9/F2GufCz8GYvyCgbHDBFXURRyuAIIQDws+Vn
hHIytpu+hHyw/9WcGcAwDgHC4edOVUTMW1Tr0HN53GWCDxwpz71+/raEfrS3F8XE
VA9eEqUDkLrcHOyKG48KuRnC3q74z/js0ZnWxtKpfZQrnAAO3Ep17E2uGdIVq5mM
GEcCAwEAAaNgMF4wHwYDVR0jBBgwFoAUT2jRV1FH5hdNQl0M5bgFbxqUxM0wHQYD
VR0OBBYEFJj6FPveGDQ+H1rYRPtuHbXPw2iEMAwGA1UdEwEB/wQCMAAwDgYDVR0P
AQH/BAQDAgeAMA0GCSqGSIb3DQEBCwUAA4IBAQAWfhdMqKO/5J30US88Px3zHnfV
ZWffO4TxdakXyxtDx0hVVan9DY19qimElDGt0YHzqlxSVMXCBQtHiFmU1kSKZBYb
PnCDnWKQLQWazAtj0jDsk9uMo5xPnjuvaWFE6JemexHC19uA2oF9VeurAI2JM8DS
T0ge8aEFLGWpyfsV7ptG0ttPsELoHdXDMXix43mcbJXeGbh5n9VxOX3qQZS/H9gg
+HdIEDNdB0toUykzbKmzQiLqxu+Ki5J6WA3v6onZhjmhlhGE8pEnucUJe0xzbHec
T9IewZS8so4UOCDyptUrBru8sIksAdp0NVhkN7zreLLpH9rjzi+BEo6qezKj
-----END CERTIFICATE-----
)KEY";

//Device Private Key for TideSim1
static const char AWS_CERT_PRIVATE[] PROGMEM = R"KEY(
-----BEGIN RSA PRIVATE KEY-----
MIIEowIBAAKCAQEA3cucmeBXiNVvoHWrMvFYp7NTA6UUWmMcUCyuu/qdKu6Jzf0w
h5lp9lEp5TIrmgpYTOhEVs57qkxqejfXlA0/YQeaKF8hvCDBHwd1uubyoy6bigPz
H2BAfWrPE7ECx0dBi7XQLKh46Y7ce7oLOnLr+iTyzZS02ffd12arjjmaYUCL8P38
XYa58LPwZi/IKBscMEVdRFHK4AghAPCz5WeEcjK2m76EfLD/1ZwZwDAOAcLh505V
RMxbVOvQc3ncZYIPHCnPvX7+toR+tLcXxcRUD14SpQOQutwc7Iobjwq5GcLervjP
+OzRmdbG0ql9lCucAA7cSnXsTa4Z0hWrmYwYRwIDAQABAoIBAQCEFANesvUNnCSM
RmY7wPNNcoFl80FKjijHKcSoVpaPgVt42mSy603pi+3J+fVzFuP8cHh5xR5pjHX/
8A8lsDnk2zUXA4fAUzUN+FBIi81EFbY0GyQFtDjTNu63yDpiV3GV9CBS58SROSzd
VS3okZUq8iPQ/tQv1OY7pn1VBcKEVGLsjtUu7MkrEqcf8duxBG/10MgMduyepJNx
/UFzyOKXYefLcLGkWbPPA4ldrvRKZ1CvNesbrk6+lBz80OUprZpSQStZ6MQ6LZ8O
VZlr0Z3Ix8jBXXoQH3ll5F3BD6IqTNvoT+nNrvLJzhdyw+uPrkjVkZV2SlsA4Dqb
wkzP6NVxAoGBAPHtxAo/AJiUJUYATZ7UYZlbb4qBtTzQYgyKRmx3KxuC+UGPPc0Q
JjSf4Vq4TU3YbtelaYU6Mt0G451SZOxUMZaYd/Q+7X4H9NZZPFmkuEi973FDw7DS
n61sCQvNl2/6HRNGnSSfndqSpZTGrKIcsCJ0WYFGpJBl/uaNBKJnYHtfAoGBAOqy
EQW6M8SSKBlZWtOzCMOKMGsUAmKPmtYVv+V9UhzvAuMW+1V2lSTLsSCdrzFRbfF1
dF3Xke1q//8echO9x6UWbCAS+JreNfecOX8QDrrMABkoD82pPbfCe1Sv8mbigXxs
P8Oij4pt+zVprpzaDcn64+bnqlWRJH7DjHGaZ3QZAoGACGMVyMUmYCPCpwqbpkX2
nDpvQ337qoAO5iBlEJ2RAQMpYPx2SAWnTWu9hEefZnN6ZD93yQabfM4gVfPlS8wf
a/kdL3p/AT+FXWj6jqEHQn5TLroKrraekoSMS7x044zoNSLdj8d40XsEAoRgt74G
3Srrb2/jhJ4EmDmLT5YF4kECgYAIgybc51EDWy27JaOGtCKoPPXenF4txvmdtDI+
l5oH1J9tLyM0iVWFfSHShgWZq1Nqg5ER6kSvsMbSMP+AOczo7vRDAY0kyNR6Q59O
PX3bRpTmVK6mDfJgHNyuSKdpFeQOaDqz1MyR/8UxvcCIjdwcLE5hzJs/+UCynFMW
t7vy2QKBgAT0tn6Reg7Qym1ijBIZE2KFEHmFWW0Xq++aeGxFxbsQ5+cpz+OXrcvW
jKfs3+j27tZCEvk4VaWiCdNz6mDx770+OtwDf6kuUJSN9DEeYm95Z+gSwID7POUn
R4l7vbbgxCTiTODqtOQdG11xJCGj8ZkxM6VU7QwSaNiZd6Jzto4E
-----END RSA PRIVATE KEY-----
)KEY";
*/

/*
// Device Certificate for TideSim2 (AKA TIDES_1)
static const char AWS_CERT_CRT[] = R"KEY(
-----BEGIN CERTIFICATE-----
MIIDWjCCAkKgAwIBAgIVAOdhHEAU2X2s8Phg05+ASuUPnJhLMA0GCSqGSIb3DQEB
CwUAME0xSzBJBgNVBAsMQkFtYXpvbiBXZWIgU2VydmljZXMgTz1BbWF6b24uY29t
IEluYy4gTD1TZWF0dGxlIFNUPVdhc2hpbmd0b24gQz1VUzAeFw0yMzA4MTYxOTM5
MzRaFw00OTEyMzEyMzU5NTlaMB4xHDAaBgNVBAMME0FXUyBJb1QgQ2VydGlmaWNh
dGUwggEiMA0GCSqGSIb3DQEBAQUAA4IBDwAwggEKAoIBAQDeJhwpaocbRL1j9ARc
YyutmDBo3FT1jPKwdpH3+9XMlMEVxeQCyG/tRZLJlFlyoGQmtxL+gUBZlCi0Li16
DA2RAQC2zXbIiqA3nPML/apeCCAmU5VAzymKBrtmGCsPzWsDV7TzHRzs5AZ1pWWQ
lMqC8GjD2i6aZ/02HQgChmujJSFXI7iASTqhwugqoRivtm0TC4oRqfbPaND5RSh+
BIneqGA24yclpuWhmpvdmU+KqC2CexxiPLXJHfFphTjJSVuOy3O85dMqyUh+Jyn2
ifxs1/E2rKd4HC67Bdid5+ud3IZMLLzmpsor3qI90RdzcaFfSI50jK6/GgtUt6t6
sq0HAgMBAAGjYDBeMB8GA1UdIwQYMBaAFDtkLDgVOYDay4Xsg01npXMw+5lwMB0G
A1UdDgQWBBRVDHNJ2ZzN7OB99t64W3IX5yNFTjAMBgNVHRMBAf8EAjAAMA4GA1Ud
DwEB/wQEAwIHgDANBgkqhkiG9w0BAQsFAAOCAQEADDBwKds/nnuFj7H+2UGnnutP
ifmcsFkHBrPyhh/BgofBkNLJbPtH4G5K591SY97mpCloe5Ce0ATGhRpcLAACa36V
dzzc3aldvT4FNo+KdH+S4Erdo8BkRqRMbKqhYCPxeMoYMLfJPNoI8wmXVQOKfdcC
lyHVm3P5As9zsEUBq+m+TUyV+LTBa2UsD4HGseBT2GU3bU2znilD/H9ThXeFOMqy
0ZUDuhSrYw8EXhvn6+D/AOJQCzPMuc865eyZB+Ldbl+se4xnwV3h888nrVGmtNIJ
raHM1W+KOhGz+cLfLfX7rV02Dm5iaIJv2m38XBGqp3BfJRZyEQnLPkLApDTJCQ==
-----END CERTIFICATE-----
)KEY";

// Device Private Key for TideSim2 (AKA TIDES_1)
static const char AWS_CERT_PRIVATE[] = R"KEY(
-----BEGIN RSA PRIVATE KEY-----
MIIEogIBAAKCAQEA3iYcKWqHG0S9Y/QEXGMrrZgwaNxU9YzysHaR9/vVzJTBFcXk
Ashv7UWSyZRZcqBkJrcS/oFAWZQotC4tegwNkQEAts12yIqgN5zzC/2qXgggJlOV
QM8piga7ZhgrD81rA1e08x0c7OQGdaVlkJTKgvBow9oummf9Nh0IAoZroyUhVyO4
gEk6ocLoKqEYr7ZtEwuKEan2z2jQ+UUofgSJ3qhgNuMnJabloZqb3ZlPiqgtgnsc
Yjy1yR3xaYU4yUlbjstzvOXTKslIficp9on8bNfxNqyneBwuuwXYnefrndyGTCy8
5qbKK96iPdEXc3GhX0iOdIyuvxoLVLererKtBwIDAQABAoIBAAynVRFS3RFDkBoi
ayEsEO/ZbGB8tGYsOiKtDlF2yc3WZ00rMXqrGh0EyoCq75Fk6299HBrdF+JCWzMw
MizyhM9OpFDFUU/I/alNSlbTgyHKCrLELgs8AZy4F3KQS9uhksfk9gynCt+/eVK4
MhnTL9nXgdAuHFt1MuojKzKhn33yY1D8CfWErJ+oRJhGv1/StScjX/u7/9vRmDaW
JseLF7IBsEY0csSW293jhVgBL6x/G2hMHMsIdZ38hZk0owy6HlnuHd39NJ80Z8YS
4k567pWqdxdYfdL5kk3+cVwYf/ws9cqC80ZKewbL+xn/kgheCoAJBmSI0r+1JmLD
o3Mp2WECgYEA8l3oEtd2r3bG56/HLd9UwhWBTteFEHe/a4tgn6G38j28Q/xx+fxC
h0rddLdBZJjpCAMwM5zHOuYZ6UdJfvIdS8dSaPKxWGDBvmK6ZVkNPrOpH/jtPIEi
ejOiTFQt4Ek479F9TpPtlIijPkwwd74G+B26dz6E5Tyyf27WaqztidECgYEA6qUQ
YOgTehHBWcySe79v7wenOzg5o1rJAh3Wc3w7FrItcgavYMxKEnDXILxsYDvTUJrT
PDhgqAx+4fRoSKmgBVogy/cv19Ieps7qcdEtqq+3PBkWXM5II4RjhhQ+8Sf/sJMv
aUzpQreHyvLiYzo/Dg9R/MU0nhA609d6GQraJ1cCgYA7Y41piIiZqFZHEYiSEgaX
5GMiKad+iIlMVgPgOeV0I3KNij93jTvUISEw53LLrrhzcSyPiRw8r4Or6P72b2eE
WRw1gTq5uEPhXhnkmbSoJ6gKoJmpWM9U+HANmhb/vZGJGmFFLvRpkC3IJy09OkBE
7ivx6kzwSzZGCafazfMK8QKBgD0AeMeYzid4IjpEUvjVBjawWKuurF1ppsRkGXKg
o4P9Ao+YaVPTCJbOuz8JfWtvYjqcZbpMNeS6iuoXbl0lrDJ4AfrE4q1LNSjMtmqs
pSCw2gRHyWaLQnnpWy5qaQqtCW5QdYz8r8/mgukiR/TgGbCADyKV6l4FfiXA6T9F
cP21AoGAW3/V8kAADj0hk3vUIvW5eiBBKmXKUUfsLeJOvRiGeu9YSUdbtxxFImlt
CvSEMjJV+sonYjzzU7N82518iv49w/B0IGpm9RFPoxaDe5ioj8eohBTcvKYtgDA0
UP8GNziqp9fhHADSAcF1vy7HWE08QSQictb3aEue0Dktpsup0+M=
-----END RSA PRIVATE KEY-----
)KEY";
*/

/*
// Device Certificate for TIDES_2
static const char AWS_CERT_CRT[] = R"KEY(
-----BEGIN CERTIFICATE-----
MIIDWTCCAkGgAwIBAgIUfjFbuxpkH+LDptvYK/bZstufy3YwDQYJKoZIhvcNAQEL
BQAwTTFLMEkGA1UECwxCQW1hem9uIFdlYiBTZXJ2aWNlcyBPPUFtYXpvbi5jb20g
SW5jLiBMPVNlYXR0bGUgU1Q9V2FzaGluZ3RvbiBDPVVTMB4XDTI2MDUyNjE4MDg0
M1oXDTQ5MTIzMTIzNTk1OVowHjEcMBoGA1UEAwwTQVdTIElvVCBDZXJ0aWZpY2F0
ZTCCASIwDQYJKoZIhvcNAQEBBQADggEPADCCAQoCggEBAM30hBlCbnOQsIr58cVq
6c6W0fQlfHBmRzPkKjvodE7tyI2DEgEoCe/udSjJqSeu8WHky32eenP7OaWXpYVr
ilYNWHdQ2QLCX1oGFguALW8X98s98pCghfBFVLFDYS90wv/TUJ5+UxeIHDaYZFI1
3j9tf+ZX6PWygGgb5OhGxmA5mEqM55SlRhIVZ7Mw2sIk7OVyoFU6HFP1FduxoHwe
g9BV5ISzSqdH3lGsDxfArizLtyMC1em0aGJazRi+TtcKiSPiyC8cS3y0PqaygnuG
ERIqX8OS39IBxIPscYcNKfwEmx97xLZVQfSUC8qYpAp2nvZfRikCAchVt6hte/Uj
C7ECAwEAAaNgMF4wHwYDVR0jBBgwFoAUv9tVoo8rO9mwuiI7odgiBrMF/mowHQYD
VR0OBBYEFItfkt4bHMDl3y1klnIF6ONa9wGHMAwGA1UdEwEB/wQCMAAwDgYDVR0P
AQH/BAQDAgeAMA0GCSqGSIb3DQEBCwUAA4IBAQBceKJ1DZMV75uNsaeFPxyp42TK
SjuurZN2YCZkQ9jsN9INKbApvEn04kLNK5tRgQKrKPksB20eqKZVAdqcg0C3LyhB
hi6p2Qk+bvvm/TJKkYTodMwIYoEGVGA3rwZGZPf3y+gUWKwdksotH/FsuRVphF3o
GviHWiwtZGJ94W0WrcgNA7B5YM8mSQf14lK9u60jHi4iG0tcnWMfWjwKbjey6u/7
fnCLza1WQoAj5jnqcT7M552+7oZG0O19ZhB4QGlWxOAiZfIr1w05IsqipwR38oHq
1VOSsv+sLuyB/DOIpJS+7tlvTzVEEwQmfudTJOo/c9bo9kT0vyebVhYuMEBw
-----END CERTIFICATE-----
)KEY";

// Device Private Key for TIDES_2
static const char AWS_CERT_PRIVATE[] = R"KEY(
-----BEGIN RSA PRIVATE KEY-----
MIIEpAIBAAKCAQEAzfSEGUJuc5CwivnxxWrpzpbR9CV8cGZHM+QqO+h0Tu3IjYMS
ASgJ7+51KMmpJ67xYeTLfZ56c/s5pZelhWuKVg1Yd1DZAsJfWgYWC4Atbxf3yz3y
kKCF8EVUsUNhL3TC/9NQnn5TF4gcNphkUjXeP21/5lfo9bKAaBvk6EbGYDmYSozn
lKVGEhVnszDawiTs5XKgVTocU/UV27GgfB6D0FXkhLNKp0feUawPF8CuLMu3IwLV
6bRoYlrNGL5O1wqJI+LILxxLfLQ+prKCe4YREipfw5Lf0gHEg+xxhw0p/ASbH3vE
tlVB9JQLypikCnae9l9GKQIByFW3qG179SMLsQIDAQABAoIBAAnbt2sCHAlaFqlA
V4tMl850t64JEVDMBIJ+XGsrsE2K4jur13PIt9kNP/xo0rj8jb9S1U65BEGC9/pu
LNUbFa8SynZDn2+bYDcN7YY1Z3dW3VyUJYU4udCLcQdfI0rDOwZF1ikQAOgycq9G
Uh8BRxcgJawf7x27opvZIfbgVGSMpxsWcY4s54Jsp9D/m/9+HNFEzlcsaQ8E7cXZ
4zNeWbemLp0F83NWw+UKIs5SMgKwGGCpwMkdc6Jd6QoiclZDt0efKAuqrI+ur1gc
VjAIpDsqWzbnDVZVuzV5YUyRcPaSsP6EKE02E6RZ85iHmwy7E+DgFSByg3n/iUQw
lWv6RfUCgYEA/3A57jlV0+VY9iDQu+2o36JuKCO1lZYoc5r99uAk9eQ1S7ibNzS4
nMsb2atr5xZvYASINklfHEHfjkGU3yCImoO1Kal7DNVUd18wHV0Vq+W7udsNgPPg
4dcqFlKoOCfQwNNX/menmyOCNlRNb/fWeAJbMhzTmTFCSlP92uWic/MCgYEAzmhw
IwHU+uuuoelAdRR0hMjNLA5dlL4gdfVTMwOR/RIVJof88aOBhug+c5Hzo4Qx0WKx
BL9n7JSQL2nE8KzKwy70RuQSVTrRNaDQJEsCnNhUVvk6hInSvlfXGlTlGvUeQyUe
kRHZuy7zUThWf9ucwa7l9x2XxNhxFwMrB5gi/ssCgYA/58fWfamnVZ2oFhWirpat
PGnqyORJBEQiiAg5l2In0mwzAYBzk1EMiRPypRxduBMtJnUdf8W3wBM599ZS7ETA
w2qzfZ83WrfDFaFn9z3Qv6zzloYOWPVOCxKQeyVyxyNG2pkNIMmh2oRdK0IkXRDe
/VfrdaLKlLRM/C5qcUDvWQKBgQC3m9u0qFqG4sQzr0PxYkLMI7uvZxAD0qUZiSN7
i79/uWgrIGj3opUEJu/26mwqltuiAQKq0IFnyDgClTnlRjAQNGKD9ToBqxKTe/vr
bPZkA2PzAjz1zYw0Wfs0pzQuKMHExO5N6e0fP4KeS1lW30qwWB6lFiP9rPPcnqrW
VJU8xQKBgQCmQ2BiGad2MdLaEMQVDxd5TxU1KfctDlhW6KeCPohlfiDCrqpbnRTl
YzM5kb+A6f3oYs2ZzKYGisq7xIibeH7Fb66KQK0X2PF7O5w/v967Bm6oj3CRYca9
BQSRCJsUrv20UfG8jlYgyrH5M0gQdZGTx7dElA/bvnqTwg51YP4ZeA==
-----END RSA PRIVATE KEY-----
)KEY";
*/
